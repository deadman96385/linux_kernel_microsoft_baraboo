## arch/x86/configs/hololens1_retail_defconfig
```kconfig
CONFIG_LOCALVERSION="-hololens1-retail"
# CONFIG_LOCALVERSION_AUTO is not set
CONFIG_IKCONFIG=y
CONFIG_IKCONFIG_PROC=y
CONFIG_BLK_DEV_INITRD=y
# CONFIG_64BIT is not set
CONFIG_SMP=y
CONFIG_X86_INTEL_LPSS=y
CONFIG_X86_GENERIC=y
CONFIG_HIGHMEM4G=y
CONFIG_EFI=y
CONFIG_EFI_STUB=y
CONFIG_MODULES=y
CONFIG_MODULE_UNLOAD=y
CONFIG_PCI=y
CONFIG_PCI_MSI=y
CONFIG_DEVTMPFS=y
CONFIG_DEVTMPFS_MOUNT=y
CONFIG_SYSFB_SIMPLEFB=y
CONFIG_SERIAL_8250=y
CONFIG_SERIAL_8250_CONSOLE=y
CONFIG_SERIAL_8250_DW=y
CONFIG_I2C_DESIGNWARE_CORE=y
CONFIG_PINCTRL_CHERRYVIEW=y
CONFIG_DRM=y
CONFIG_DRM_FBDEV_EMULATION=y
CONFIG_DRM_SIMPLEDRM=y
CONFIG_USB=y
CONFIG_USB_XHCI_HCD=m
CONFIG_USB_DWC3=m
CONFIG_USB_GADGET=m
CONFIG_USB_CONFIGFS=m
CONFIG_USB_CONFIGFS_ACM=y
CONFIG_MMC=y
CONFIG_MMC_SDHCI=y
CONFIG_MMC_SDHCI_PCI=y
CONFIG_MMC_SDHCI_ACPI=y
CONFIG_NEW_LEDS=y
CONFIG_LEDS_CLASS=y
CONFIG_LEDS_LM3532=m
CONFIG_TMPFS=y
```
